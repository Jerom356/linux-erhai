#include "sm8750.dtsi"
/*
 * Add IPA support as a seperate file for now so that reverting
 * would be easier
 */
&soc {
	ipa: ipa@3f40000 {
		compatible = "qcom,sm8750-ipa";

		iommus = <&apps_smmu 0x4a0 0x0>,
		<&apps_smmu 0x4a2 0x0>;
		reg = <0 0x3f40000 0 0x10000>,
		<0 0x3f50000 0 0x5000>,
		<0 0x3e04000 0 0xfc000>;
		reg-names = "ipa-reg",
		"ipa-shared",
		"gsi";

		interrupts-extended = <&intc GIC_SPI 655 IRQ_TYPE_EDGE_RISING 0>,
		<&intc GIC_SPI 432 IRQ_TYPE_LEVEL_HIGH 0>,
		<&ipa_smp2p_in 0 IRQ_TYPE_EDGE_RISING>,
		<&ipa_smp2p_in 1 IRQ_TYPE_EDGE_RISING>;
		interrupt-names = "ipa",
		"gsi",
		"ipa-clock-query",
		"ipa-setup-ready";

		clocks = <&rpmhcc RPMH_IPA_CLK>;
		clock-names = "core";

		interconnects = <&aggre2_noc MASTER_IPA QCOM_ICC_TAG_ALWAYS
		&mc_virt SLAVE_EBI1 QCOM_ICC_TAG_ALWAYS>,
		<&gem_noc MASTER_APPSS_PROC QCOM_ICC_TAG_ACTIVE_ONLY
		&config_noc SLAVE_IPA_CFG QCOM_ICC_TAG_ACTIVE_ONLY>;
		interconnect-names = "memory",
		"config";

		qcom,qmp = <&aoss_qmp>;

		qcom,smem-states = <&ipa_smp2p_out 0>,
		<&ipa_smp2p_out 1>;
		qcom,smem-state-names = "ipa-clock-enabled-valid",
		"ipa-clock-enabled";

		status = "disabled";
	};
};

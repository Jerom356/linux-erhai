## drivers/input/keyboard/pogo_keyboard/Kconfig
```kconfig
#
# The pogo keyboard drivers.
#
menuconfig KEYBOARD_POGO
    tristate "Pogo Keypad Support"
    help
      Say Y here if you want to use the keypad.
      To compile this driver as a module, choose M here.

if KEYBOARD_POGO

config KEYBOARD_POGO_INPUT_IS_TOUCH
    bool "Configure touchpad input as touchscreen (default is mouse)"
    default n
    help
      Say Y here to process the input in touchscreen mode (absolute coordinates)
      for the keyboard touchpad. If N, it will behave as a standard
      mouse (relative movement).

endif # KEYBOARD_POGO
```

## drivers/input/touchscreen/nt36536_nf/Kconfig
```kconfig
config TOUCHPANEL_NT36536_NF
#	default y
	tristate "Novatek NT36536 Non-flash SPI driver"
	help
	Say Y to enable driver for Novatek nt36536_noflash touch driver
	Or M to compile as a module.
```

## sound/soc/codecs/aw882xx/Kconfig
```kconfig
config SND_SOC_AW882XX
	tristate "Awinic AW882XX Smart PA support"
	depends on I2C
        select REGMAP_I2C
        select GPIOLIB
	help
	  Press Y or M to enable support for Awinic AW882XX Smart PA.
```
